## CMakeLists.txt
```
cmake_minimum_required(VERSION 3.20.0)
find_package(Zephyr REQUIRED HINTS $ENV{ZEPHYR_BASE})
set(BOARD_FLASH_RUNNER openocd)
project(chip8_interpreter)

target_sources(app PRIVATE src/main.c)
```

## prj.conf
```kconfig
CONFIG_PRINTK=y
CONFIG_SERIAL=y
CONFIG_CONSOLE=y
CONFIG_UART_CONSOLE=y
CONFIG_GPIO=y
```

## src/main.c
```c
#define _POSIX_C_SOURCE 199309L
#include <time.h>

#include "chip8.h"
#include <stdio.h>

#define CYCLES_PER_FRAME 10
#define FRAME_US 16666667L

static void draw(const chip8_t *chip) {
  printf("\033[H"); // move cursor to top-left
  for (int y = 0; y < SCREEN_H; y++) {
    for (int x = 0; x < SCREEN_W; x++) {
      putchar(chip->fb[y * SCREEN_W + x] ? '#' : ' ');
    }
    putchar('\n');
  }
  fflush(stdout);
}

int main(int argc, char *argv[]) {
  if (argc < 2) {
    fprintf(stderr, "usage: %s <rom.ch8>\n", argv[0]);
    return 1;
  }
  printf("chip-8 emulator\n");

  chip8_t chip;

  chip8_init(&chip);

  printf("loading program...\n");

  FILE *f = fopen(argv[1], "rb");
  if (!f) {
    perror("fopen");
    return 1;
  }

  uint8_t buf[MEM_SIZE - START_ADDRESS + 1];
  size_t n = fread(buf, 1, sizeof buf, f);
  fclose(f);

  if (!chip8_load_rom(&chip, buf, n)) {
    fprintf(stderr, "chip8: ROM too large\n");
    return 1;
  }

  printf("chip8: successfully loaded ROM (%s)\n", argv[1]);

  size_t i;
  int k = 0;
  for (i = 0; i < n; i++) {
    if (k == 8) {
      printf("\n");
      k = 0;
    }
    printf("0x%.2X ", buf[i]);
    k++;
  }
  printf("\n");

  printf("\033[2J"); // clear terminal once
  for (;;) {
    for (int i = 0; i < CYCLES_PER_FRAME; i++) {
      chip8_cycle(&chip);
    }
    chip8_tick_timers(&chip);
    draw(&chip);
    struct timespec ts = {0, FRAME_US};
    nanosleep(&ts, NULL);
  }
  return 0;
}
```

## src/chip8.c
```c
#include "chip8.h"
#include <stdint.h>
#include <string.h>

static void _op_draw(chip8_t *chip, uint8_t x, uint8_t y, uint8_t n) {
  // starting position wraps around screen
  uint8_t px = chip->V[x] % SCREEN_W;
  uint8_t py = chip->V[y] % SCREEN_H;

  chip->V[0xF] = 0;

  for (uint8_t row = 0; row < n; row++) {
    if (py + row >= SCREEN_H) {
      break; // clip at bottom edge
    }

    uint8_t sprite = chip->mem[chip->I + row];

    for (uint8_t col = 0; col < 8; col++) {
      if (px + col >= SCREEN_W) {
        break; // clip at right edge
      }

      if (sprite & (0x80 >> col)) {
        uint8_t *pixel = &chip->fb[(py + row) * SCREEN_W + (px + col)];
        if (*pixel) {
          chip->V[0xF] = 1; // a lit pixel is being turned off;collision
        }
        *pixel ^= 1;
      }
    }
  }
}

void chip8_init(chip8_t *chip) {
  // clear memory, display & registers
  memset(chip, 0, sizeof *chip);

  // set program counter to the start (0x200)
  chip->pc = START_ADDRESS;

  memcpy(&chip->mem[FONT_START], fontset, sizeof fontset);

  srand(time(NULL));
}

bool chip8_load_rom(chip8_t *chip, const uint8_t *data, size_t size) {
  if (size > MEM_SIZE - START_ADDRESS) {
    return false;
  }
  memcpy(&chip->mem[START_ADDRESS], data, size);
  return true;
}

void chip8_cycle(chip8_t *chip) {
  if (chip->pc > MEM_SIZE - 2) {
    fprintf(stderr, "chip8: PC out of bounds! PC: 0x%03X\n", chip->pc);
    return;
  }

  uint16_t opcode = (chip->mem[chip->pc] << 8) | chip->mem[chip->pc + 1];
  LOG("pc=0x%03X op=0x%04X\n", chip->pc, opcode);
  chip->pc += 2;

  uint8_t x = (opcode >> 8) & 0xF;
  uint8_t y = (opcode >> 4) & 0xF;
  uint8_t n = opcode & 0xF;
  uint8_t nn = opcode & 0xFF;
  uint16_t nnn = opcode & 0xFFF;

  // switch instruction family
  switch (opcode & 0xF000) {
  case 0x0000: /* 00E0 CLS, 00EE RET */
    if (opcode == 0x00E0)
      memset(chip->fb, 0, sizeof chip->fb);
    else if (opcode == 0x00EE) {
      if (chip->sp == 0) {
        fprintf(stderr, "chip8: stack underflow! PC: 0x%03X\n", chip->pc - 2);
        return;
      }
      chip->pc = chip->stack[--chip->sp];
    }
    break;
  case 0x1000: /* 1nnn JP addr */
    chip->pc = nnn;
    break;
  case 0x2000: /* CALL addr */
    if (chip->sp >= 16) {
      fprintf(stderr, "chip8: stack overflow! PC: 0x%03X Target: 0x%03X\n",
              chip->pc - 2, nnn);
      for (int i = 0; i < 16; i++) {
        LOG("stack[%d]: 0x%03X\n", i, chip->stack[i]);
      }
      return;
    }
    chip->stack[chip->sp++] = chip->pc;
    chip->pc = nnn;
    break;
  case 0x3000: /* SE Vx, byte */
    if (chip->V[x] == nn)
      chip->pc += 2;
    break;
  case 0x4000: /* SNE Vx, byte */
    if (chip->V[x] != nn)
      chip->pc += 2;
    break;
  case 0x5000: /* SE Vx, Vy */
    if (chip->V[x] == chip->V[y])
      chip->pc += 2;
    break;
  case 0x6000: /* LD Vx, byte */
    chip->V[x] = nn;
    break;
  case 0x7000: /* ADD Vx, byte */
    chip->V[x] += nn;
    break;
  case 0x8000:
    switch (n) {
      uint16_t sum;
      uint8_t diff;
      uint8_t flag;
    case 0x0: /* LD Vx, Vy */
      chip->V[x] = chip->V[y];
      break;
    case 0x1: /* OR Vx, Vy*/
      chip->V[x] = chip->V[x] | chip->V[y];
      break;
    case 0x2: /* AND Vx, Vy */
      chip->V[x] = chip->V[x] & chip->V[y];
      break;
    case 0x3: /* XOR Vx, Vy */
      chip->V[x] = chip->V[x] ^ chip->V[y];
      break;
    case 0x4: /* ADD Vx, Vy */
      sum = chip->V[x] + chip->V[y];
      chip->V[x] = sum & 0xFF;
      chip->V[0xF] = sum > 255;
      break;
    case 0x5: /* SUB Vx, Vy */
      diff = chip->V[x] - chip->V[y];
      flag = chip->V[x] >= chip->V[y];
      chip->V[x] = diff;
      chip->V[0xF] = flag;
      break;
    case 0x6: /* SHR Vx {, Vy} */
      flag = chip->V[x] & 0x1;
      chip->V[x] >>= 1;
      chip->V[0xF] = flag;
      break;
    case 0x7: /* SUBN Vx, Vy */
      diff = chip->V[y] - chip->V[x];
      flag = chip->V[y] >= chip->V[x];
      chip->V[x] = diff;
      chip->V[0xF] = flag;
      break;
    case 0xE: /* SHL Vx {, Vy} */
      flag = chip->V[x] >> 7;
      chip->V[x] <<= 1;
      chip->V[0xF] = flag;
      break;
    }
    break;
  case 0x9000: /* SNE Vx, Vy */
    if (chip->V[x] != chip->V[y])
      chip->pc += 2;
    break;
  case 0xA000: /* LD I, addr */
    chip->I = nnn;
    break;
  case 0xB000: /* JP V0, addr */
    chip->pc = nnn + chip->V[0];
    break;
  case 0xC000: /* RND Vx, byte */
    chip->V[x] = (rand() & 0xFF) & nn;
    break;
  case 0xD000: /* DRW Vx, Vy, nibble */
    _op_draw(chip, x, y, n);
    break;
  case 0xE000:
    switch (nn) {
    case 0x9E: /* SKP Vx */
      if (chip->keypad[chip->V[x] & 0xF])
        chip->pc += 2;
      break;
    case 0xA1: /* SKNP Vx */
      if (!chip->keypad[chip->V[x] & 0xF])
        chip->pc += 2;
      break;
    }
    break;
  case 0xF000:
    switch (nn) {
    case 0x07: /* LD Vx, DT */
      chip->V[x] = chip->delay_timer;
      break;
    case 0x0A: /* LD Vx, K */
    {
      int k;
      for (k = 0; k < 16 && !chip->keypad[k]; k++)
        ;
      if (k < 16)
        chip->V[x] = k;
      else
        chip->pc -= 2; /* no key pressed: re-run this instruction next cycle */
    } break;
    case 0x15: /* LD DT, Vx */
      chip->delay_timer = chip->V[x];
      break;
    case 0x18: /* LD ST, Vx */
      chip->sound_timer = chip->V[x];
      break;
    case 0x1E: /* ADD I, Vx */
      chip->I = chip->I + chip->V[x];
      break;
    case 0x29: /* LD F, Vx */
      chip->I = FONT_START + (chip->V[x] & 0xF) * 5;
      break;
    case 0x33: /* LD B, Vx */
      if (chip->I + 2 >= MEM_SIZE) {
        fprintf(stderr, "chip8: BCD out of bounds! PC: 0x%03X I: 0x%03X\n",
                chip->pc - 2, chip->I);
        return;
      }
      chip->mem[chip->I] = chip->V[x] / 100;
      chip->mem[chip->I + 1] = (chip->V[x] / 10) % 10;
      chip->mem[chip->I + 2] = chip->V[x] % 10;
      break;
    case 0x55: /* LD [I], Vx */
      if (chip->I + x >= MEM_SIZE) {
        fprintf(stderr, "chip8: store out of bounds! PC: 0x%03X I: 0x%03X\n",
                chip->pc - 2, chip->I);
        return;
      }
      for (int i = 0; i <= x; i++)
        chip->mem[chip->I + i] = chip->V[i];
      break;
    case 0x65: /* LD Vx, [I] */
      if (chip->I + x >= MEM_SIZE) {
        fprintf(stderr, "chip8: load out of bounds! PC: 0x%03X I: 0x%03X\n",
                chip->pc - 2, chip->I);
        return;
      }
      for (int i = 0; i <= x; i++)
        chip->V[i] = chip->mem[chip->I + i];
      break;
    }
    break;
  default:
    fprintf(stderr, "chip8: unhandled opcode 0x%04X at PC 0x%03X\n", opcode,
            chip->pc - 2);
    break;
  }
}

void chip8_tick_timers(chip8_t *chip) {
  if (chip->delay_timer > 0) {
    chip->delay_timer--;
  }
  if (chip->sound_timer > 0) {
    chip->sound_timer--;
  }
}
```

## src/chip8.h
```c
#ifndef CHIP8_H
#define CHIP8_H

#include <stdbool.h>
#include <stddef.h>
#include <stdint.h>
#include <stdio.h>
#include <stdlib.h>
#include <time.h>

#define MEM_SIZE (1 << 12)
#define START_ADDRESS 0x200
#define FONT_START 0x50

#define SCREEN_W 64
#define SCREEN_H 32

#ifdef DEBUG
#define LOG(...) fprintf(stderr, "[chip8] " __VA_ARGS__)
#else
#define LOG(...) ((void)0)
#endif

static const uint8_t fontset[80] = {
    0xF0, 0x90, 0x90, 0x90, 0xF0, // 0
    0x20, 0x60, 0x20, 0x20, 0x70, // 1
    0xF0, 0x10, 0xF0, 0x80, 0xF0, // 2
    0xF0, 0x10, 0xF0, 0x10, 0xF0, // 3
    0x90, 0x90, 0xF0, 0x10, 0x10, // 4
    0xF0, 0x80, 0xF0, 0x10, 0xF0, // 5
    0xF0, 0x80, 0xF0, 0x90, 0xF0, // 6
    0xF0, 0x10, 0x20, 0x40, 0x40, // 7
    0xF0, 0x90, 0xF0, 0x90, 0xF0, // 8
    0xF0, 0x90, 0xF0, 0x10, 0xF0, // 9
    0xF0, 0x90, 0xF0, 0x90, 0x90, // A
    0xE0, 0x90, 0xE0, 0x90, 0xE0, // B
    0xF0, 0x80, 0x80, 0x80, 0xF0, // C
    0xE0, 0x90, 0x90, 0x90, 0xE0, // D
    0xF0, 0x80, 0xF0, 0x80, 0xF0, // E
    0xF0, 0x80, 0xF0, 0x80, 0x80  // F
};

typedef struct chip8_t {
  uint8_t mem[MEM_SIZE];
  uint8_t V[16]; // 16 general-purpose 8-bit registers

  uint16_t I;  // 16-bit index register  for memory address
  uint16_t pc; // 16-bit program counter (points to current instruction)

  uint16_t stack[16]; // 16-level call stack for subroutines
  uint8_t sp;         // 8-bit stack pointer

  uint8_t delay_timer;
  uint8_t sound_timer;

  uint8_t keypad[16];

  uint8_t fb[SCREEN_W * SCREEN_H];
} chip8_t;

void chip8_init(chip8_t *chip);
bool chip8_load_rom(chip8_t *chip, const uint8_t *data, size_t size);
void chip8_cycle(chip8_t *chip);
void chip8_tick_timers(chip8_t *chip);

#endif // CHIP8_H
```
